## ZEPHYR_SIWX917y_EK_WIFI_MQTT/boards/silabs/dev_kits/siwx917y_ek/Kconfig.siwx917y_ek
```kconfig
# SiWx917Y Explorer Kit board configuration

config BOARD_SIWX917Y_EK
	select SOC_PART_NUMBER_SIWG917M111MGTBA
```

## ZEPHYR_SIWX917y_EK_WIFI_MQTT/boards/silabs/dev_kits/siwx917y_ek/board.yml
```yaml
board:
  name: siwx917y_ek
  full_name: SiWx917 Wi-Fi 6 and Bluetooth LE SoC 8 MB Flash Radio Board (siwx917y_ek)
  vendor: silabs
  socs:
    - name: siwg917m111mgtba
```
